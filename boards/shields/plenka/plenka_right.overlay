/* plenka_right.overlay */
#include "plenka.dtsi"

&default_transform {
    col-offset = <10>;
};

&kscan0 {
    status = "okay";
    row-gpios
        = <&pro_micro 6 (GPIO_ACTIVE_HIGH | GPIO_PULL_DOWN)>  // Row 0
        , <&pro_micro 7 (GPIO_ACTIVE_HIGH | GPIO_PULL_DOWN)>  // Row 1
        , <&pro_micro 8 (GPIO_ACTIVE_HIGH | GPIO_PULL_DOWN)>  // Row 2
        , <&pro_micro 5 (GPIO_ACTIVE_HIGH | GPIO_PULL_DOWN)>  // Row 3 (Thumb Right)
        ;

    col-gpios
        = <&pro_micro 10 GPIO_ACTIVE_HIGH> // Col 5
        , <&pro_micro 16 GPIO_ACTIVE_HIGH> // Col 6
        , <&pro_micro 14 GPIO_ACTIVE_HIGH> // Col 7
        , <&pro_micro 15 GPIO_ACTIVE_HIGH> // Col 8
        , <&pro_micro 18 GPIO_ACTIVE_HIGH> // Col 9
        ;
};

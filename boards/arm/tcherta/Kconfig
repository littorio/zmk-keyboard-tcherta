## boards/arm/tcherta/Kconfig
```kconfig
#
# Copyright (c) 2022 The ZMK Contributors
# SPDX-License-Identifier: MIT
#

config BOARD_TCHERTA_LEFT
    bool

config BOARD_TCHERTA_RIGHT
    bool

config CONFIG_ZMK_BATTERY_REPORTING
    bool
```

## boards/arm/tcherta/Kconfig.defconfig
```kconfig
#
# Copyright (c) 2022 Darryl deHaan
# SPDX-License-Identifier: MIT
#

if BOARD_TCHERTA_LEFT

config ZMK_KEYBOARD_NAME
    default "Tcherta"

config ZMK_SPLIT_ROLE_CENTRAL
    default y

config ZMK_DISPLAY
    default y

if ZMK_DISPLAY

config SPI
    default y

# config IL0323
#    default y

config ZMK_DISPLAY_BLANK_ON_IDLE
    default y

# Needed for the IL0323 driver which allocs memory to clear the display
# config HEAP_MEM_POOL_SIZE
#    default 1024

endif # ZMK_DISPLAY


#FIXME JNP Are those 'widgets' applicable to Tcherta? Not remains of Corneish-Zen?
 menuconfig CUSTOM_WIDGET_BATTERY_STATUS
    bool "custom battery status widget"

#menuconfig CUSTOM_WIDGET_OUTPUT_STATUS
#    bool "custom output status widget"

#menuconfig CUSTOM_WIDGET_LAYER_STATUS
#    bool "custom layer status widget"

#menuconfig CUSTOM_WIDGET_PERIPHERAL_STATUS
#    bool "custom peripheral status widget"

endif # BOARD_TCHERTA_LEFT


if BOARD_TCHERTA_LEFT || BOARD_TCHERTA_RIGHT

config CONFIG_ZMK_BATTERY_REPORTING
    default y

config ZMK_DISPLAY
    default y

if ZMK_DISPLAY

config SPI
    default y

# config IL0323
#    default y

config ZMK_DISPLAY_BLANK_ON_IDLE
    default y

# Needed for the IL0323 driver which allocs memory to clear the display
# config HEAP_MEM_POOL_SIZE
#    default 1024

endif # ZMK_DISPLAY

config BOARD
    default "tcherta"

config ZMK_SPLIT
    default y

config BT_CTLR
    default BT

if USB

config USB_NRFX
    default y

config USB_DEVICE_STACK
    default y

endif # USB

endif # BOARD_TCHERTA_LEFT || BOARD_TCHERTA_RIGHT
```

## boards/shields/plenka/Kconfig.shield
```kconfig
config SHIELD_PLENKA_LEFT
    def_bool $(shields_list_contains,plenka_left)

#config SHIELD_PLENKA_RIGHT
#    def_bool $(shields_list_contains,plenka_right)
```

## boards/shields/tcherta/Kconfig.shield
```kconfig
config SHIELD_TCHERTA
    def_bool $(shields_list_contains,tcherta_left)

#config SHIELD_TCHERTA_RIGHT
#    def_bool $(shields_list_contains,tcherta_right)
```

## west.yml
```yaml
manifest:
  remotes:
    - name: zmkfirmware
      url-base: https://github.com/zmkfirmware
    - name: urob
      url-base: https://github.com/urob
    - name: littorio
      url-base: https://github.com/littorio
  projects:
    - name: zmk
      remote: zmkfirmware
      revision: v0.3
      import: app/west.yml
    - name: zmk-adaptive-key
      remote: urob
      revision: v0.3
    - name: zmk-helpers
      remote: urob
      revision: main
    - name: zmk-orbita-layout
      remote: littorio
      revision: main
  self:
    path: config
```

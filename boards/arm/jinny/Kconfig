## boards/arm/jinny/Kconfig
```kconfig
#
# Copyright (c) 2022 The ZMK Contributors
# SPDX-License-Identifier: MIT
#

config BOARD_CORNEISH_ZEN_LEFT
    bool
```

## boards/arm/jinny/Kconfig.board
```kconfig
#
# Copyright (c) 2022 Darryl deHaan
# SPDX-License-Identifier: MIT
#

config BOARD_CORNEISH_ZEN_V4_LEFT
    bool "corneish zen left v2"
    depends on SOC_NRF52840_QIAA
    select BOARD_CORNEISH_ZEN_LEFT
```

## boards/arm/jinny/Kconfig.defconfig
```kconfig
#
# Copyright (c) 2022 Darryl deHaan
# SPDX-License-Identifier: MIT
#

if BOARD_CORNEISH_ZEN_LEFT

config ZMK_KEYBOARD_NAME
    default "Corne-ish Zen"

config ZMK_SPLIT_ROLE_CENTRAL
    default y

endif # BOARD_CORNEISH_ZEN_LEFT


if BOARD_CORNEISH_ZEN_LEFT || BOARD_CORNEISH_ZEN_RIGHT

config BOARD
    default "jinny"

config ZMK_SPLIT
    default y

config BT_CTLR
    default BT

if USB

config USB_NRFX
    default y

config USB_DEVICE_STACK
    default y

endif # USB

menuconfig CUSTOM_WIDGET_BATTERY_STATUS
    bool "custom battery status widget"

menuconfig CUSTOM_WIDGET_OUTPUT_STATUS
    bool "custom output status widget"

menuconfig CUSTOM_WIDGET_LAYER_STATUS
    bool "custom layer status widget"

menuconfig CUSTOM_WIDGET_PERIPHERAL_STATUS
    bool "custom peripheral status widget"

endif # BOARD_CORNEISH_ZEN_LEFT || BOARD_CORNEISH_ZEN_RIGHT
```

## boards/arm/tcherta/Kconfig.board
```kconfig
#
# Copyright (c) 2022 Darryl deHaan
# SPDX-License-Identifier: MIT
#

config BOARD_TCHERTA_V0_LEFT
    bool "tcherta"
    depends on SOC_NRF52840_QIAA
    select BOARD_TCHERTA_LEFT

config BOARD_TCHERTA_V0_RIGHT
    bool "tcherta"
    depends on SOC_NRF52840_QIAA
    select BOARD_TCHERTA_RIGHT
```
